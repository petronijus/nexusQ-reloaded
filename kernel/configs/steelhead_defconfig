## kernel/configs/steelhead_defconfig
```kconfig
# Google Nexus Q (steelhead) kernel configuration
# Based on omap2plus_defconfig with device-specific additions
# Target: postmarketOS, mainline Linux 6.12 LTS, ARMv7 (OMAP4460)

# ============================================================
# Core platform (from omap2plus_defconfig, trimmed to OMAP4)
# ============================================================
CONFIG_KERNEL_GZIP=y
# CONFIG_KERNEL_LZMA is not set
CONFIG_SYSVIPC=y
CONFIG_POSIX_MQUEUE=y
CONFIG_AUDIT=y
CONFIG_NO_HZ_IDLE=y
CONFIG_HIGH_RES_TIMERS=y
CONFIG_BSD_PROCESS_ACCT=y
CONFIG_IKCONFIG=y
CONFIG_IKCONFIG_PROC=y
CONFIG_LOG_BUF_SHIFT=16
CONFIG_CGROUPS=y
CONFIG_MEMCG=y
CONFIG_BLK_CGROUP=y
CONFIG_CGROUP_SCHED=y
CONFIG_CFS_BANDWIDTH=y
CONFIG_RT_GROUP_SCHED=y
CONFIG_CGROUP_FREEZER=y
CONFIG_CPUSETS=y
CONFIG_CGROUP_DEVICE=y
CONFIG_CGROUP_CPUACCT=y
CONFIG_CGROUP_PERF=y
CONFIG_NAMESPACES=y
CONFIG_BLK_DEV_INITRD=y
CONFIG_EXPERT=y
CONFIG_PROFILING=y
CONFIG_ARCH_MULTI_V7=y
# CONFIG_OMAP_RESET_CLOCKS is not set
CONFIG_ARCH_OMAP4=y
# CONFIG_POWER_AVS_OMAP is not set
# CONFIG_POWER_AVS_OMAP_CLASS3 is not set
CONFIG_ARM_THUMBEE=y
# SMP disabled: U-Boot 2011.09 leaves CPU1 in undefined state, causing
# mainline SMP startup to hang. Single-core boot is reliable.
# CONFIG_SMP is not set
CONFIG_ARM_APPENDED_DTB=y
# ATAG_DTB_COMPAT disabled: U-Boot passes ATAGs that crash the
# decompressor's ATAG-to-DTB merge code. Appended DTB is sufficient.
# CONFIG_ARM_ATAG_DTB_COMPAT is not set
CONFIG_CMDLINE="console=tty0 console=ttyS2,115200 earlyprintk loglevel=7 ignore_loglevel panic=30"
CONFIG_CMDLINE_FORCE=y
CONFIG_KEXEC=y
CONFIG_CPU_FREQ=y
CONFIG_CPU_FREQ_DEFAULT_GOV_ONDEMAND=y
CONFIG_CPU_FREQ_GOV_POWERSAVE=y
CONFIG_CPU_FREQ_GOV_USERSPACE=y
CONFIG_CPU_FREQ_GOV_CONSERVATIVE=y
CONFIG_CPUFREQ_DT=m
# CONFIG_ARM_OMAP2PLUS_CPUFREQ is not set
CONFIG_CPU_IDLE=y
CONFIG_ARM_CPUIDLE=y
CONFIG_KERNEL_MODE_NEON=y
CONFIG_PM_DEBUG=y
CONFIG_MODULES=y
CONFIG_MODULE_FORCE_LOAD=y
CONFIG_MODULE_UNLOAD=y
CONFIG_MODULE_FORCE_UNLOAD=y
CONFIG_MODVERSIONS=y
CONFIG_MODULE_SRCVERSION_ALL=y
CONFIG_PARTITION_ADVANCED=y
CONFIG_BINFMT_MISC=y
CONFIG_CMA=y

# ============================================================
# Networking
# ============================================================
CONFIG_NET=y
CONFIG_PACKET=y
CONFIG_UNIX=y
CONFIG_XFRM_USER=y
CONFIG_NET_KEY=y
CONFIG_INET=y
CONFIG_IP_MULTICAST=y
CONFIG_IP_PNP=y
CONFIG_IP_PNP_DHCP=y
CONFIG_IP_PNP_BOOTP=y
CONFIG_IPV6=y
CONFIG_NETFILTER=y
CONFIG_NF_CONNTRACK=m
CONFIG_NF_TABLES=m
CONFIG_NF_TABLES_INET=y
CONFIG_NFT_CT=m
CONFIG_NFT_LOG=m
CONFIG_NFT_LIMIT=m
CONFIG_NFT_MASQ=m
CONFIG_NFT_NAT=m
CONFIG_NFT_REJECT=m
CONFIG_NFT_COMPAT=m
CONFIG_NETFILTER_XT_TARGET_LOG=m
CONFIG_NETFILTER_XT_TARGET_MARK=m
CONFIG_NETFILTER_XT_TARGET_TCPMSS=m
CONFIG_NETFILTER_XT_MATCH_CONNTRACK=m
CONFIG_NETFILTER_XT_MATCH_MARK=m
CONFIG_NETFILTER_XT_MATCH_MULTIPORT=m
CONFIG_NETFILTER_XT_MATCH_STATE=m
CONFIG_IP_NF_IPTABLES=m
CONFIG_IP_NF_FILTER=m
CONFIG_IP_NF_TARGET_REJECT=m
CONFIG_IP_NF_NAT=m
CONFIG_IP_NF_TARGET_MASQUERADE=m
CONFIG_IP_NF_MANGLE=m
CONFIG_IP6_NF_IPTABLES=m
CONFIG_IP6_NF_FILTER=m
CONFIG_IP6_NF_MANGLE=m
CONFIG_BRIDGE=m
CONFIG_NET_SCHED=y
CONFIG_NET_SCH_INGRESS=m
CONFIG_NET_CLS_U32=m
CONFIG_NET_CLS_ACT=y
CONFIG_NET_ACT_POLICE=m

# Bluetooth
CONFIG_BT=m
CONFIG_BT_RFCOMM=m
CONFIG_BT_RFCOMM_TTY=y
CONFIG_BT_BNEP=m
CONFIG_BT_HIDP=m
CONFIG_BT_HCIUART=m
CONFIG_BT_HCIUART_BCSP=y
CONFIG_BT_HCIUART_LL=y
CONFIG_BT_HCIUART_3WIRE=y
CONFIG_BT_HCIUART_BCM=y

# WiFi
CONFIG_CFG80211=m
CONFIG_CFG80211_WEXT=y
CONFIG_MAC80211=m

# ============================================================
# Device drivers
# ============================================================
CONFIG_DEVTMPFS=y
CONFIG_DEVTMPFS_MOUNT=y
CONFIG_OMAP_OCP2SCP=y
CONFIG_CONNECTOR=m

# Block
CONFIG_BLK_DEV_LOOP=y
CONFIG_BLK_DEV_RAM=y
CONFIG_BLK_DEV_RAM_SIZE=16384

# SCSI (for USB storage)
CONFIG_BLK_DEV_SD=y
CONFIG_SCSI_SCAN_ASYNC=y

# Ethernet (SMSC LAN9500A via USB) -- built-in for early network
CONFIG_NETDEVICES=y
CONFIG_USB_NET_SMSC95XX=y
CONFIG_USB_USBNET=y

# WiFi (Broadcom BCM4330 via SDIO -- NOT TI WL12xx)
CONFIG_WLAN=y
CONFIG_WLAN_VENDOR_BROADCOM=y
CONFIG_BRCMUTIL=m
CONFIG_BRCMFMAC=m
CONFIG_BRCMFMAC_SDIO=y

# NFC (NXP PN544)
CONFIG_NFC=m
CONFIG_NFC_HCI=m
CONFIG_NFC_PN544=m
CONFIG_NFC_PN544_I2C=m

# Input
CONFIG_INPUT_EVDEV=m
CONFIG_INPUT_MISC=y
CONFIG_INPUT_UINPUT=m
# CONFIG_INPUT_MOUSE is not set

# Serial / Console
CONFIG_SERIAL_8250=y
CONFIG_SERIAL_8250_CONSOLE=y
CONFIG_SERIAL_8250_NR_UARTS=32
CONFIG_SERIAL_8250_RUNTIME_UARTS=6
CONFIG_SERIAL_8250_EXTENDED=y
CONFIG_SERIAL_8250_SHARE_IRQ=y
CONFIG_SERIAL_8250_OMAP=y
CONFIG_SERIAL_OF_PLATFORM=y
CONFIG_SERIAL_DEV_BUS=y

# I2C
CONFIG_I2C_CHARDEV=y

# SPI
CONFIG_SPI=y
CONFIG_SPI_OMAP24XX=y

# Pinctrl
CONFIG_PINCTRL_SINGLE=y

# GPIO
CONFIG_DEBUG_GPIO=y
CONFIG_GPIO_SYSFS=y
CONFIG_GPIO_TWL4030=y

# Power
CONFIG_POWER_RESET=y
CONFIG_POWER_RESET_GPIO=y

# PMIC / Regulators (TWL6030)
CONFIG_MFD_CPCAP=y
CONFIG_MFD_PALMAS=y
CONFIG_MFD_TPS65217=y
CONFIG_TWL6040_CORE=y
CONFIG_REGULATOR_GPIO=y
CONFIG_REGULATOR_PALMAS=y
CONFIG_REGULATOR_PBIAS=y
CONFIG_REGULATOR_TI_ABB=y
CONFIG_REGULATOR_TPS62360=m
CONFIG_REGULATOR_TPS65023=y
CONFIG_REGULATOR_TWL4030=y

# Thermal
CONFIG_THERMAL_GOV_FAIR_SHARE=y
CONFIG_THERMAL_GOV_USER_SPACE=y
CONFIG_CPU_THERMAL=y
CONFIG_TI_THERMAL=y
CONFIG_OMAP4_THERMAL=y

# Watchdog
CONFIG_WATCHDOG=y
CONFIG_OMAP_WATCHDOG=m

# Hardware monitor
CONFIG_HWMON=m
CONFIG_SENSORS_TMP102=m

# ============================================================
# Display / DRM (HDMI output, software rendering)
# Built-in for HDMI framebuffer console during early boot
# ============================================================
CONFIG_DRM=y
CONFIG_DRM_OMAP=y
CONFIG_OMAP5_DSS_HDMI=y
CONFIG_OMAP2_DSS_DSI=y
CONFIG_DRM_PANEL_SIMPLE=y
CONFIG_DRM_DISPLAY_CONNECTOR=y
CONFIG_DRM_SIMPLE_BRIDGE=y
CONFIG_DRM_TI_TFP410=y
CONFIG_DRM_TI_TPD12S015=y
CONFIG_FB=y
CONFIG_FRAMEBUFFER_CONSOLE=y
CONFIG_FRAMEBUFFER_CONSOLE_ROTATION=y
CONFIG_LOGO=y

# ============================================================
# Audio (ALSA / ASoC)
# ============================================================
CONFIG_SOUND=m
CONFIG_SND=m
CONFIG_SND_USB_AUDIO=m
CONFIG_SND_SOC=m
CONFIG_SND_SOC_OMAP_ABE_TWL6040=m
CONFIG_SND_SOC_OMAP_HDMI=m
CONFIG_SND_SOC_TAS571X=m
CONFIG_SND_SIMPLE_CARD=m
CONFIG_SND_AUDIO_GRAPH_CARD=m

# ============================================================
# USB
# Built-in for early USB host (Ethernet) and gadget (RNDIS)
# ============================================================
CONFIG_USB=y
CONFIG_USB_ANNOUNCE_NEW_DEVICES=y
CONFIG_USB_MON=m
CONFIG_USB_EHCI_HCD=y
CONFIG_USB_OHCI_HCD=m
CONFIG_USB_ACM=m
CONFIG_USB_STORAGE=m
CONFIG_USB_MUSB_HDRC=y
CONFIG_USB_MUSB_OMAP2PLUS=y
CONFIG_USB_INVENTRA_DMA=y
CONFIG_USB_DWC3=m
CONFIG_NOP_USB_XCEIV=y
CONFIG_TWL6030_USB=y
CONFIG_USB_GADGET=y
CONFIG_USB_CONFIGFS=y
CONFIG_USB_CONFIGFS_SERIAL=y
CONFIG_USB_CONFIGFS_ACM=y
CONFIG_USB_CONFIGFS_NCM=y
CONFIG_USB_CONFIGFS_ECM=y
CONFIG_USB_CONFIGFS_ECM_SUBSET=y
CONFIG_USB_CONFIGFS_RNDIS=y
CONFIG_USB_CONFIGFS_EEM=y
CONFIG_USB_CONFIGFS_MASS_STORAGE=y
CONFIG_USB_CONFIGFS_F_FS=y
CONFIG_USB_CONFIGFS_F_HID=y

# ============================================================
# MMC / eMMC
# ============================================================
CONFIG_MMC=y
CONFIG_SDIO_UART=y
CONFIG_MMC_SDHCI=y
CONFIG_MMC_SDHCI_PLTFM=y
CONFIG_MMC_OMAP=y
CONFIG_MMC_OMAP_HS=y
CONFIG_MMC_SDHCI_OMAP=y

# ============================================================
# LEDs (LP5523 via AVR MCU)
# ============================================================
CONFIG_NEW_LEDS=y
CONFIG_LEDS_CLASS=m
CONFIG_LEDS_GPIO=m
CONFIG_LEDS_LP55XX_COMMON=m
CONFIG_LEDS_LP5523=m
CONFIG_LEDS_PWM=m
CONFIG_LEDS_TRIGGERS=y
CONFIG_LEDS_TRIGGER_TIMER=m
CONFIG_LEDS_TRIGGER_ONESHOT=m
CONFIG_LEDS_TRIGGER_HEARTBEAT=m
CONFIG_LEDS_TRIGGER_DEFAULT_ON=m

# ============================================================
# RTC / Clocks / DMA
# ============================================================
CONFIG_RTC_CLASS=y
CONFIG_RTC_DRV_TWL4030=m
CONFIG_RTC_DRV_OMAP=m
CONFIG_DMADEVICES=y
CONFIG_CLK_TWL=m
CONFIG_CLK_TWL6040=m
CONFIG_OMAP_IOMMU=y
CONFIG_REMOTEPROC=y
CONFIG_SOC_TI=y
CONFIG_TI_EMIF=m

# ============================================================
# IIO (sensors)
# ============================================================
CONFIG_IIO=m
CONFIG_TWL6030_GPADC=m

# PWM
CONFIG_PWM=y
CONFIG_PWM_OMAP_DMTIMER=m
CONFIG_PWM_TWL=m

# PHY -- built-in for early USB
CONFIG_OMAP_USB2=y
CONFIG_TI_PIPE3=y

# ============================================================
# Filesystems
# ============================================================
CONFIG_EXT2_FS=y
CONFIG_EXT3_FS=y
CONFIG_EXT4_FS_SECURITY=y
CONFIG_FANOTIFY=y
CONFIG_QUOTA=y
CONFIG_QFMT_V2=y
CONFIG_AUTOFS_FS=m
CONFIG_MSDOS_FS=y
CONFIG_VFAT_FS=y
CONFIG_TMPFS=y
CONFIG_TMPFS_POSIX_ACL=y
CONFIG_SQUASHFS=y
CONFIG_SQUASHFS_XZ=y
CONFIG_NFS_FS=y
CONFIG_NFS_V3_ACL=y
CONFIG_NFS_V4=y
CONFIG_ROOT_NFS=y
CONFIG_NLS_CODEPAGE_437=y
CONFIG_NLS_ISO8859_1=y
CONFIG_F2FS_FS=y
CONFIG_OVERLAY_FS=y
CONFIG_FUSE_FS=m

# ============================================================
# postmarketOS requirements
# ============================================================
CONFIG_FHANDLE=y
CONFIG_INOTIFY_USER=y
CONFIG_SIGNALFD=y
CONFIG_TIMERFD=y
CONFIG_EPOLL=y
CONFIG_SECURITY=y
CONFIG_SECCOMP=y
CONFIG_DEVTMPFS=y
CONFIG_DEVTMPFS_MOUNT=y

# ============================================================
# Crypto
# ============================================================
CONFIG_CRYPTO_MICHAEL_MIC=y
CONFIG_CRYPTO_SHA1_ARM_NEON=m
CONFIG_CRYPTO_SHA256_ARM=m
CONFIG_CRYPTO_AES_ARM=m
CONFIG_CRYPTO_AES_ARM_BS=m
CONFIG_CRYPTO_CHACHA20_NEON=m

# ============================================================
# Debugging (minimal)
# ============================================================
CONFIG_CRC_CCITT=y
CONFIG_CRC7=y
CONFIG_LIBCRC32C=y
CONFIG_DMA_CMA=y
CONFIG_FONTS=y
CONFIG_FONT_8x8=y
CONFIG_FONT_8x16=y
CONFIG_PRINTK_TIME=y
CONFIG_MAGIC_SYSRQ=y
CONFIG_DEBUG_FS=y
CONFIG_EARLY_PRINTK=y
```

## kernel/drivers/Kconfig.steelhead
```kconfig
# Kconfig stanzas for the Google Nexus Q steelhead-AVR LED ring driver.
#
# These hunks are applied into the in-tree kernel build files by the Task 8
# patch. They are kept here verbatim so the patch can reuse the exact text.
#
# Target file: drivers/leds/Kconfig
# (insert the two config blocks below into the LED drivers menu)

config LEDS_STEELHEAD_AVR
	tristate "Google Nexus Q steelhead-AVR LED ring + keys"
	depends on I2C && OF
	select LEDS_CLASS
	select LEDS_CLASS_MULTICOLOR
	select INPUT
	help
	  32 RGB ring LEDs + mute LED and the capacitive mute/volume keys on the
	  Google Nexus Q, behind the steelhead-AVR MCU on i2c.

config LEDS_STEELHEAD_AVR_KUNIT_TEST
	tristate "KUnit tests for steelhead-AVR" if !KUNIT_ALL_TESTS
	depends on LEDS_STEELHEAD_AVR && KUNIT
	default KUNIT_ALL_TESTS

# Target file: drivers/leds/Makefile
# (append the two obj lines below)
#
# obj-$(CONFIG_LEDS_STEELHEAD_AVR)            += leds-steelhead-avr.o
# obj-$(CONFIG_LEDS_STEELHEAD_AVR_KUNIT_TEST) += leds-steelhead-avr-test.o
```
